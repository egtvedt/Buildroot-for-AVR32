## package/avr32-bootsplash/Config.in
```kconfig
config BR2_PACKAGE_AVR32_BOOTSPLASH
	bool "avr32-bootsplash"
	select BR2_PACKAGE_FBV
	help
	  This package shows a splash image on the LCD screen while
	  booting, and a different splash image when the target is
	  ready.
```

## package/avr32-web-start/Config.in
```kconfig
config BR2_PACKAGE_AVR32_WEB_START
	bool "avr32-web-start"
	default n
	help
	  This package adds a welcome web homepage, i.e. /www/index.html,
	  intended for use on Atmel AVR32 target boards.

config BR2_PACKAGE_AVR32_WEB_START_GPIO
	bool "add gpio demo to avr32-web-start"
	depends on BR2_PACKAGE_AVR32_WEB_START
	default n
	help
	  Enable a GPIO demo which is usually used for toggling a LED on the
	  board. Normally added for demonstration purposes.
```

## package/avr32-wiki-docs/Config.in
```kconfig
config BR2_PACKAGE_AVR32_WIKI_DOCS
	bool "avr32-wiki-docs"
	default n
	help
	  This package adds the AVR32 wiki documentation snapshot to the /www
	  folder on your target board file system.

	  http://www.atmel.com/AVR32

config BR2_PACKAGE_AVR32_WIKI_DOCS_ROOT_INDEX_FILE
	bool "Redirecting index.html in /www"
	depends on BR2_PACKAGE_AVR32_WIKI_DOCS
	default y
	help
	  Enabling this option adds a index.html in /www directory which
	  automatically redirects the user to /www/wiki when browsing the Wiki
	  through a web client.
```

## package/faad2/Config.in
```kconfig
config BR2_PACKAGE_FAAD2
	bool "faad2"
	default n
	help
	  FAAD2 is an open source MPEG-4 and MPEG-2 AAC decoder, it is licensed
	  under the GPLv2 license.  Features:

	    * Portable
	    * Reasonably fast
	    * LC, Main, LTP, SBR, PS support
	    * DRM support through DreaM

	  Source packages are available in the downloads section. No binary
	  distributions are available here, because they require a patent
	  license.

	  http://www.audiocoding.com/faad2.html

config BR2_PACKAGE_FAAD2_PLAYER
	bool "faad AAC decoder"
	default n
	depends on BR2_PACKAGE_FAAD2
	help
	  Install the faad AAC decoder.
```

## package/libid3tag/Config.in
```kconfig
config BR2_PACKAGE_LIBID3TAG
	bool "libid3tag"
	default n
	depends on BR2_PACKAGE_LIBMAD
	help
	  ID3 tag library support for libmad, a high-quality MPEG audio
	  decoder. It currently supports MPEG-1 and the MPEG-2 extension to
	  lower sampling frequencies, as well as the de facto MPEG 2.5 format.
	  All three audio layers — Layer I, Layer II, and Layer III (i.e. MP3)
	  — are fully implemented.

	  http://www.underbit.com/products/mad/
```

## package/lsdldoom/Config.in
```kconfig
config BR2_PACKAGE_LSDLDOOM
	bool "lsdldoom"
	depends on BR2_PACKAGE_SDL
	help
	  This is the linux version of the popular doom game using the SDL
	  library, lsdldoom is an alternative to the lxdoom package.

	  It is recommended to add the SDL_mixer package for audio support, but
	  it is not required.
```

## package/ltp/Config.in
```kconfig
config BR2_PACKAGE_LTP
	bool "Linux Test Project"
	help
	  The Linux Test Project provides a huge testsuite for Linux.

	  http://ltp.sourceforge.net/
```

## package/lxdoom/Config.in
```kconfig
config BR2_PACKAGE_LXDOOM
	bool "lxdoom"
	help
	  This is the linux version of the popular doom game.
config BR2_PACKAGE_LXDOOM_WAD
	bool "doom shareware wad file"
	depends on BR2_PACKAGE_LXDOOM || BR2_PACKAGE_LSDLDOOM
	help
	  This will install the the shareware wad data file for the doom game.

	  The wad file will be placed in /usr/share/games/doom/doom1.wad
```

## package/mplayer/Config.in
```kconfig
config BR2_PACKAGE_MPLAYER
	bool "mplayer"
	select BR2_PACKAGE_LIBMAD
	help
	  MPlayer is a movie player which runs on many systems and supports
	  many different file formats.

	  http://www.mplayerhq.hu/

choice
	prompt "faad library"
	default BR2_PACKAGE_MPLAYER_FAAD_INTERNAL_FIXED
	depends on BR2_PACKAGE_MPLAYER
	help
	  Selects the library type for AAC decoding using libfaad.

config BR2_PACKAGE_MPLAYER_FAAD_INTERNAL_FLOAT
	bool "internal floating point libfaad"
config BR2_PACKAGE_MPLAYER_FAAD_INTERNAL_FIXED
	bool "internal fixed point libfaad"
config BR2_PACKAGE_MPLAYER_FAAD_EXTERNAL
	bool "external libfaad"
	select BR2_PACKAGE_FAAD2
endchoice

config BR2_PACKAGE_MPLAYER_LIBMAD
	bool "use libmad for mp3 decoding"
	default y
	depends on BR2_PACKAGE_MPLAYER
	select BR2_PACKAGE_LIBMAD
	help
	  Use libmad for decoding mp3.
```

## package/system-upgrade/Config.in
```kconfig
config BR2_PACKAGE_SYSTEM_UPGRADE
	bool "System Upgrade Utility"
	help
	  This is a utility for doing automated upgrades of the on-board
	  flash filesystem.

config BR2_PACKAGE_SYSTEM_UPGRADE_BOARD_NAME
	depends on BR2_PACKAGE_SYSTEM_UPGRADE
	string "Board name for system-upgrade"
	help
	  The name of the board for which to build the system-upgrade
	  utility. This affects the image path on the SD card, the
	  default environment variables, partitioning, etc.
```

## target/bootloader/u-boot/Config.in
```kconfig
config BR2_TARGET_U_BOOT
	bool "U-Boot"
	default n
	depends on BR2_avr32
	help
	  U-Boot, the universal boot loader for multiple platforms and target
	  boards.

	  http://www.denx.de/wiki/UBoot/

config BR2_TARGET_U_BOOT_CONFIG_BOARD
	string "U-Boot target board configuration"
	depends on BR2_TARGET_U_BOOT
	help
	  Set this variable to the target board you want to configure U-Boot
	  for. This will use the default options for this board in U-Boot and
	  build accordingly.

	  For example "atstk1002_config" for ATSTK1000 with ATSTK1002 top
	  module for the AVR32 starter kit.
```

## target/device/Atmel/Config.in
```kconfig
comment "Atmel board support"

choice
	prompt "AVR32 board type"
	default BR2_TARGET_ATMEL_ATSTK1000

config BR2_TARGET_ATMEL_ATSTK1000
	bool "ATSTK1000 development board"
	depends BR2_avr32
	help
	  Support for the ATSTK1000 development board for Atmel AVR32.

config BR2_TARGET_ATMEL_ATNGW100
	bool "ATNGW100 reference board"
	depends BR2_avr32
	help
	  Support for the ATNGW100 reference board for Atmel AVR32.

endchoice
```

## target/device/Config.in
```kconfig
menu "Target options"

# Boards may select this to remove some features that are only useful on
# targets that have a virtual console.
config BR2_BOARD_IS_HEADLESS
	bool

comment "Preset Devices"

source "target/device/ARMLTD/Config.in"
source "target/device/Atmel/Config.in"
source "target/device/KwikByte/Config.in"
source "target/device/valka/Config.in"
source "target/device/x86/Config.in"
source "target/device/xtensa/Config.in"

# This must be last
source "target/generic/Config.in"

endmenu
```

## target/device/EarthLCD/Config.in
```kconfig
menuconfig BR2_TARGET_EARTHLCD
	bool "EarthLCD boards"
	depends on BR2_avr32

if BR2_TARGET_EARTHLCD

choice
	prompt "Board support"
	default BR2_TARGET_EARTHLCD_FAVR_32_EZKIT
	help
	  Select the specific EarthLCD board for the target system.

config BR2_TARGET_EARTHLCD_FAVR_32_EZKIT
	bool "EarthLCD Favr-32 kit"
	help
	  The EarthLCD Favr-32 CPU module mounted on the ezLCD-101 motherboard.

endchoice

config BR2_BOARD_NAME
	string
	default "favr-32-ezkit" if BR2_TARGET_EARTHLCD_FAVR_32_EZKIT

config BR2_BOARD_PATH
	string "EarthLCD board repository"
	default "target/device/EarthLCD/$(BR2_BOARD_NAME)"
	help
	  Path to directory containing EarthLCD board configurations.

endif
```

## target/jffs2/Config.in
```kconfig
menuconfig BR2_TARGET_ROOTFS_JFFS2
	bool "jffs2 root filesystem"
	select BR2_HOST_FAKEROOT
	select BR2_PACKAGE_MTD
	help
	  Build a jffs2 root filesystem

if BR2_TARGET_ROOTFS_JFFS2

config BR2_TARGET_ROOTFS_JFFS2_READ_PARTITION_SETUP
	bool "Read partition setup from file"
	default n
	help
	  Read partition table setup from a file and split the root filesystem
	  accordingly.

	  Sample setup file: target/jffs2/jffs2_partitions.txt.sample

	  If you plan to have a huge file system for your target you should
	  answer n to this option.

config BR2_TARGET_ROOTFS_JFFS2_READ_PARTITION_SETUP_FILE
	string "Partition setup file"
	default "$(BR2_BOARD_PATH)/jffs2_partitions.txt"
	depends on BR2_TARGET_ROOTFS_JFFS2_READ_PARTITION_SETUP
	help
	  Path to a file which holds the partition setup.

if !BR2_TARGET_ROOTFS_JFFS2_READ_PARTITION_SETUP

choice
	prompt "Memory Type"
	default BR2_TARGET_ROOTFS_JFFS2_FLASH_128
	depends on BR2_TARGET_ROOTFS_JFFS2

config BR2_TARGET_ROOTFS_JFFS2_DATAFLASH_1056
	bool "AT45 dataflash with 1056 byte pagesize"
	depends on BR2_TARGET_ROOTFS_JFFS2
	select BR2_TARGET_ROOTFS_JFFS2_NOCLEANMARKER

config BR2_TARGET_ROOTFS_JFFS2_DATAFLASH_528
	bool "AT45 dataflash with 528 byte pagesize"
	depends on BR2_TARGET_ROOTFS_JFFS2
	select BR2_TARGET_ROOTFS_JFFS2_NOCLEANMARKER

config BR2_TARGET_ROOTFS_JFFS2_FLASH_128
	bool "Parallel flash with 4 kB pagesize and 128 kB erase size"
	depends on BR2_TARGET_ROOTFS_JFFS2

config BR2_TARGET_ROOTFS_JFFS2_FLASH_64
	bool "Parallel flash with 4 kB pagesize and 64 kB erase size"
	depends on BR2_TARGET_ROOTFS_JFFS2

config BR2_TARGET_ROOTFS_JFFS2_CUSTOM
	bool "Select custom page and erase size"
	depends on BR2_TARGET_ROOTFS_JFFS2

endchoice

config BR2_TARGET_ROOTFS_JFFS2_CUSTOM_PAGESIZE
	hex "Page Size"
	depends on BR2_TARGET_ROOTFS_JFFS2_CUSTOM
	default 0x1000
	help
	  Set to pagesize of memory

config BR2_TARGET_ROOTFS_JFFS2_CUSTOM_EBSIZE
	hex "Erase block size"
	depends on BR2_TARGET_ROOTFS_JFFS2_CUSTOM
	default 0x20000
	help
	  Set to erase size of memory

config BR2_TARGET_ROOTFS_JFFS2_PAGESIZE
	hex
	depends on BR2_TARGET_ROOTFS_JFFS2
	default 0x420 if BR2_TARGET_ROOTFS_JFFS2_DATAFLASH_1056
	default 0x210 if BR2_TARGET_ROOTFS_JFFS2_DATAFLASH_528
	default 0x1000 if BR2_TARGET_ROOTFS_JFFS2_FLASH_128
	default 0x1000 if BR2_TARGET_ROOTFS_JFFS2_FLASH_64
	default $(BR2_TARGET_ROOTFS_JFFS2_CUSTOM_PAGESIZE) if BR2_TARGET_ROOTFS_JFFS2_CUSTOM
	help
	  Set to pagesize of memory

config BR2_TARGET_ROOTFS_JFFS2_EBSIZE
	hex "Erase block size"
	depends on BR2_TARGET_ROOTFS_JFFS2
	default 0x2100 if BR2_TARGET_ROOTFS_JFFS2_DATAFLASH_1056
	default 0x1080 if BR2_TARGET_ROOTFS_JFFS2_DATAFLASH_528
	default 0x20000 if BR2_TARGET_ROOTFS_JFFS2_FLASH_128
	default 0x10000 if BR2_TARGET_ROOTFS_JFFS2_FLASH_64
	default $(BR2_TARGET_ROOTFS_JFFS2_CUSTOM_EBSIZE) if BR2_TARGET_ROOTFS_JFFS2_CUSTOM
	help
	  Set to Erase Size of memory

config BR2_TARGET_ROOTFS_JFFS2_NOCLEANMARKER
	bool "Do not use Cleanmarker"
	depends on BR2_TARGET_ROOTFS_JFFS2
	help
	  Do not use cleanmarkers if using NAND flash or Dataflash where
	  the pagesize is not a power of 2

config BR2_JFFS2_TARGET_SREC
	bool "RootFS in SREC file formet"
	depends on BR2_TARGET_ROOTFS_JFFS2

config BR2_TARGET_ROOTFS_JFFS2_PAD
	bool "Pad output"
	help
	  Pad the output image with 0xFF in unused space.

config BR2_TARGET_ROOTFS_JFFS2_PADSIZE
	hex "Pad output size (0x0 = to end of EB)"
	default 0x0
	depends on BR2_TARGET_ROOTFS_JFFS2_PAD
	help
	  Pad the image up to a given size, if set to 0x0 the image is padded
	  to the end of the final erase block.

endif # !BR2_TARGET_ROOTFS_JFFS2_READ_PARTITION_SETUP

config BR2_JFFS2_TARGET_SREC
	bool "Generate SREC file format"
	default n
	help
	  Generate S-records file format for the target.

choice
	prompt "Endianess"
	default BR2_TARGET_ROOTFS_JFFS2_LE if BR2_ENDIAN = "LITTLE"
	default BR2_TARGET_ROOTFS_JFFS2_BE if BR2_ENDIAN = "BIG"
	help
	  Select the endianess layout of the flash image, this should normally
	  match your architecture endianess.

config BR2_TARGET_ROOTFS_JFFS2_LE
	bool "little-endian"
	depends on BR2_TARGET_ROOTFS_JFFS2

config BR2_TARGET_ROOTFS_JFFS2_BE
	bool "big-endian"
	depends on BR2_TARGET_ROOTFS_JFFS2

endchoice

config BR2_TARGET_ROOTFS_JFFS2_SQUASH
	bool "Make all files be owned by root"
	depends on BR2_TARGET_ROOTFS_JFFS2

config BR2_TARGET_ROOTFS_JFFS2_SUMMARY
	bool "Produce a summarized JFFS2 image"
	depends on BR2_TARGET_ROOTFS_JFFS2
    help
      A summarised image can be mounted faster if support is
      enabled in the kernel (CONFIG_JFFS2_SUMMARY)

config BR2_TARGET_ROOTFS_JFFS2_OUTPUT
	string "Output file(s)"
	default "$(IMAGE).jffs2"
	help
	  Name of the output file, if partition setup is enable a
	  -<partition name> will be appended to the end of the file name.

config BR2_TARGET_ROOTFS_JFFS2_COPYTO
	string "also copy the image to..."
	depends on BR2_TARGET_ROOTFS_JFFS2
	default ""
	help
	  Copies the resulting image(s) to a secondary location.

endif # BR2_TARGET_ROOTFS_JFFS2
```

## target/u-boot/Config.in
```kconfig
config BR2_TARGET_UBOOT
	bool "Das U-Boot Boot Monitor"
	depends on !BR2_TARGET_AT91
	help
	  Build "Das U-Boot" Boot Monitor

config BR2_TARGET_UBOOT_BOARDNAME
	string "board name"
	depends on BR2_TARGET_UBOOT
	default "$(BOARD_NAME)"
	help
	  One of U-Boot supported boards to be built.
	  This will be suffixed with _config to meet U-Boot standard naming.

config BR2_TARGET_UBOOT_CUSTOM_PATCH
	string "custom patch"
	depends on BR2_TARGET_UBOOT
	help
	  If your board requires a custom patch, add the path to the file here.
	  Most users may leave this empty

config BR2_TARGET_UBOOT_BOOTCMD
	string "bootcmd"
	depends on BR2_TARGET_UBOOT
	help
	  Override the boot command with this string.

	  Example flash boot:
	    fsload 0x10300000 /boot/uImage; bootm

	  Example MMC/SD boot:
	    mmcinit; ext2load mmc 0:1 0x10300000 /boot/uImage; bootm

	  Example network boot:
	    dhcp 0x10300000 uImage; bootm

config BR2_TARGET_UBOOT_BOOTARGS
	string "bootargs"
	depends on BR2_TARGET_UBOOT
	help
	  Override the boot arguments with this string.

	  Example arguments when booting from flash:
	    console=ttyS0 root=/dev/mtdblock1 rootfstype=jffs2

	  Example arguments when booting from MMC/SD:
	    console=ttyS0 root=/dev/mmcblk0p1

	  Example arguments when booting from network:
	    console=ttyS0 root=1.2.3.4:/nfs/root ip=dhcp

config BR2_TARGET_UBOOT_SERVERIP
	string "server ip"
	depends on BR2_TARGET_UBOOT
	default "10.175.196.221"
	help
	  TFTP server ip address

config BR2_TARGET_UBOOT_IPADDR
	string "ip address"
	depends on BR2_TARGET_UBOOT
	default "10.175.196.18"
	help
	  Target ip address

config BR2_TARGET_UBOOT_GATEWAY
	string "gateway ip"
	depends on BR2_TARGET_UBOOT
	default "10.175.196.1"
	help
	  Gateway ip address

config BR2_TARGET_UBOOT_NETMASK
	string "netmask"
	depends on BR2_TARGET_UBOOT
	default "255.255.255.0"
	help
	  Network Mask

config BR2_TARGET_UBOOT_ETHADDR
	string "ethernet address"
	depends on BR2_TARGET_UBOOT
	default "04:25:fe:ed:00:18"
	help
	  Target MAC address for the ethernet interface.
	  This should be changed for production units

config BR2_TARGET_UBOOT_ETH1ADDR
	string "ethernet 2 address"
	depends on BR2_TARGET_UBOOT
	depends on BR2_TARGET_AVR32
	help
	  Target MAC address for the second ethernet interface.

config BR2_TARGET_UBOOT_SILENT
	bool "silent console"
	depends on BR2_TARGET_UBOOT
	help
	  If the option has been enabled, the output can be
	  silenced by setting the environment variable "silent".

config BR2_TARGET_UBOOT_TOOL_MKIMAGE
	bool "mkimage tool in target"
	depends on BR2_TARGET_UBOOT
	help
	  Install mkimage tool in target.

config BR2_TARGET_UBOOT_TOOL_ENV
	bool "fw_printenv tool in target"
	depends on BR2_TARGET_UBOOT
	help
	  Install fw_printenv / fw_setenv tools in target.
```
